#pragma once
// ==================== PWA: تثبيت الواجهة كتطبيق ====================
// المسارات: /manifest.webmanifest  /sw.js  /icon-192.png  /icon-512.png
// (ملاحظة: كروم بيسمح بالتثبيت الحقيقي بس على HTTPS أو لو الـ IP متفعّل في
//  chrome://flags/#unsafely-treat-insecure-origin-as-secure)
#include <Arduino.h>
#include <WebServer.h>

extern WebServer server;

const uint8_t pwa_icon192[] PROGMEM = {
  0x89,0x50,0x4e,0x47,0x0d,0x0a,0x1a,0x0a,0x00,0x00,0x00,0x0d,0x49,0x48,0x44,0x52,0x00,0x00,0x00,0xc0,
  0x00,0x00,0x00,0xc0,0x04,0x03,0x00,0x00,0x00,0xa0,0xf2,0x71,0x34,0x00,0x00,0x00,0x30,0x50,0x4c,0x54,
  0x45,0xff,0xff,0xff,0xfe,0xff,0xff,0xf1,0xf5,0xfe,0x61,0x8f,0xf3,0x27,0x66,0xef,0x26,0x63,0xeb,0x25,
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  0x42,0x60,0x82,
};
const size_t pwa_icon192_len = 2223;

const uint8_t pwa_icon512[] PROGMEM = {
  0x89,0x50,0x4e,0x47,0x0d,0x0a,0x1a,0x0a,0x00,0x00,0x00,0x0d,0x49,0x48,0x44,0x52,0x00,0x00,0x02,0x00,
  0x00,0x00,0x02,0x00,0x04,0x03,0x00,0x00,0x00,0x06,0x56,0xc9,0xc9,0x00,0x00,0x00,0x30,0x50,0x4c,0x54,
  0x45,0xff,0xff,0xff,0xfe,0xff,0xff,0xfc,0xfd,0xff,0x9e,0xb9,0xf6,0x27,0x66,0xf0,0x26,0x63,0xeb,0x25,
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  0x00,0x00,0x00,0x49,0x45,0x4e,0x44,0xae,0x42,0x60,0x82,
};
const size_t pwa_icon512_len = 6071;

const char pwa_manifest[] PROGMEM = R"rawliteral({
"id":"/",
"name":"Voice Hub",
"short_name":"Voice Hub",
"description":"التحكم في المساعد الصوتي والمشترك والـ IR",
"start_url":"/",
"scope":"/",
"display":"standalone",
"orientation":"portrait",
"dir":"rtl",
"lang":"ar",
"background_color":"#0b1220",
"theme_color":"#0f172a",
"icons":[
{"src":"/icon-192.png","sizes":"192x192","type":"image/png","purpose":"any"},
{"src":"/icon-512.png","sizes":"512x512","type":"image/png","purpose":"any"},
{"src":"/icon-512.png","sizes":"512x512","type":"image/png","purpose":"maskable"}
],
"shortcuts":[
{"name":"المشترك","short_name":"المشترك","url":"/?tab=strip","icons":[{"src":"/icon-192.png","sizes":"192x192","type":"image/png"}]},
{"name":"الأوامر","short_name":"الأوامر","url":"/?tab=cmds","icons":[{"src":"/icon-192.png","sizes":"192x192","type":"image/png"}]}
]
})rawliteral";

// Service worker: الصفحة الرئيسية network-first (آخر نسخة تتخزن للأوفلاين)، و/api و/update عمرها ما بتتخزن
const char pwa_sw[] PROGMEM = R"rawliteral(
const CACHE='voicehub-v1';
self.addEventListener('install',e=>{self.skipWaiting();});
self.addEventListener('activate',e=>{e.waitUntil(caches.keys().then(ks=>Promise.all(ks.filter(k=>k!==CACHE).map(k=>caches.delete(k)))).then(()=>self.clients.claim()));});
self.addEventListener('fetch',e=>{
  const r=e.request,u=new URL(r.url);
  if(r.method!=='GET'||u.origin!==location.origin)return;
  if(u.pathname.startsWith('/api/')||u.pathname.startsWith('/update'))return;
  if(r.mode==='navigate'){
    e.respondWith(fetch(r).then(res=>{if(res.ok){const c=res.clone();caches.open(CACHE).then(ch=>ch.put('/',c));}return res;}).catch(()=>caches.match('/').then(m=>m||new Response('الجهاز غير متصل',{status:503,headers:{'Content-Type':'text/plain; charset=utf-8'}}))));
    return;
  }
  if(u.pathname.startsWith('/icon-')){
    e.respondWith(caches.match(r).then(m=>m||fetch(r).then(res=>{if(res.ok){const c=res.clone();caches.open(CACHE).then(ch=>ch.put(r,c));}return res;})));
  }
});
)rawliteral";

static void pwaRegisterRoutes() {
  server.on("/manifest.webmanifest", HTTP_GET, []() {
    server.sendHeader("Cache-Control", "no-cache");
    server.send_P(200, "application/manifest+json", pwa_manifest);
  });
  server.on("/sw.js", HTTP_GET, []() {
    server.sendHeader("Cache-Control", "no-cache");
    server.sendHeader("Service-Worker-Allowed", "/");
    server.send_P(200, "application/javascript", pwa_sw);
  });
  server.on("/icon-192.png", HTTP_GET, []() {
    server.sendHeader("Cache-Control", "public, max-age=604800");
    server.send_P(200, "image/png", (const char*)pwa_icon192, pwa_icon192_len);
  });
  server.on("/icon-512.png", HTTP_GET, []() {
    server.sendHeader("Cache-Control", "public, max-age=604800");
    server.send_P(200, "image/png", (const char*)pwa_icon512, pwa_icon512_len);
  });
}
